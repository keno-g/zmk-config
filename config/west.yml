## config/west.yml
```yaml
#Once the PRs are merged into the main ZMK, this file can be rewriting with default code
manifest:
  remotes:
    - name: urob
      url-base: https://github.com/urob
  projects:
    - name: zmk
      remote: urob
      revision: main
      import: app/west.yml
  self:
    path: config
```
